## boards/arm/numble/Kconfig
```kconfig
# SPDX-License-Identifier: MIT

if BOARD_NUMBLE

config BOARD_ENABLE_DCDC
	bool "DCDC mode"
	select SOC_DCDC_NRF52X
	default y

config BOARD_ENABLE_DCDC_HV
	bool "High Voltage DCDC converter"
	select SOC_DCDC_NRF52X_HV
	default y

endif
```

## boards/arm/numble/Kconfig.board
```kconfig
# SPDX-License-Identifier: MIT

config BOARD_NUMBLE
    bool "NumBLE"
    depends on SOC_NRF52840_QIAA
```

## boards/arm/numble/numble_defconfig
```kconfig
# SPDX-License-Identifier: MIT

CONFIG_SOC_SERIES_NRF52X=y
CONFIG_SOC_NRF52840_QIAA=y
CONFIG_BOARD_NUMBLE=y
CONFIG_BUILD_OUTPUT_UF2=y

CONFIG_ARM_MPU=y
CONFIG_GPIO=y
CONFIG_PINCTRL=y

# Place application at &code_partition address
CONFIG_USE_DT_CODE_PARTITION=y

# Enable NVS for settings
CONFIG_MPU_ALLOW_FLASH_WRITE=y
CONFIG_NVS=y
CONFIG_SETTINGS_NVS=y
CONFIG_FLASH=y
CONFIG_FLASH_PAGE_LAYOUT=y
CONFIG_FLASH_MAP=y

CONFIG_ZMK_BLE=y
CONFIG_ZMK_USB=y
```

## zmk-config/boards/arm/numble/Kconfig.defconfig
```kconfig
# SPDX-License-Identifier: MIT

if BOARD_NUMBLE

config ZMK_KEYBOARD_NAME
    default "NumBLE"

if USB

config USB_NRFX
    default y

config USB_DEVICE_STACK
    default y

endif # USB

config BT_CTLR
    default BT

config ZMK_BLE
    default y

config ZMK_USB
    default y

config ZMK_BATTERY_NRF_VDDH
    default y

endif # BOARD_NUMBLE
```

## zmk-config/boards/arm/numble/numble_defconfig
```kconfig
# SPDX-License-Identifier: MIT

CONFIG_SOC_SERIES_NRF52X=y
CONFIG_SOC_NRF52840_QIAA=y
CONFIG_BOARD_NUMBLE=y

# Enable MPU
CONFIG_ARM_MPU=y

# Enable GPIO
CONFIG_GPIO=y

# Place application at &code_partition address
CONFIG_USE_DT_CODE_PARTITION=y

# Enable NVS for settings
CONFIG_MPU_ALLOW_FLASH_WRITE=y
CONFIG_NVS=y
CONFIG_SETTINGS_NVS=y
CONFIG_FLASH=y
CONFIG_FLASH_PAGE_LAYOUT=y
CONFIG_FLASH_MAP=y

# nRF52840 can handle faster USB polling
CONFIG_USB_HID_POLL_INTERVAL_MS=1

# Uncomment to enable encoder
# CONFIG_EC11=y
# CONFIG_EC11_TRIGGER_GLOBAL_THREAD=y

# Uncomment to enable fuel gauge sensor
# CONFIG_I2C=y
# CONFIG_MAX17055=y

# Uncomment to enable battery voltage ADC
# CONFIG_ZMK_BATTERY_NRF_VDDH=y

# Uncomment to enable logging
# CONFIG_ZMK_USB_LOGGING=y
```
